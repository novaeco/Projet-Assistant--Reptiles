## Kconfig.projbuild
```kconfig
menu "Hardware Configuration"

config SPI_MOSI_PIN
    int "SPI MOSI pin"
    default 7

config SPI_SCLK_PIN
    int "SPI SCLK pin"
    default 6

config SPI_CS_PIN
    int "SPI CS pin"
    default 10

config I2C_SDA_PIN
    int "I2C SDA pin"
    default 3

config I2C_SCL_PIN
    int "I2C SCL pin"
    default 2

config TOUCH_INT_PIN
    int "Touch interrupt pin"
    default 4

config BACKLIGHT_PIN
    int "Backlight GPIO"
    default 5

config BACKLIGHT_LEDC_CHANNEL
    int "Backlight LEDC channel"
    default 0

endmenu

config WIFI_SSID
    string "WiFi SSID"
    default "MyWiFi"

config WIFI_PASSWORD
    string "WiFi Password"
    default "MyPassword"
```

## components/board/Kconfig
```kconfig
menu "Board Support"

menu "LCD Timing"

config BOARD_LCD_PCLK_HZ
    int "LCD pixel clock (Hz)"
    default 51200000
    help
        Pixel clock for the RGB panel. 51.2 MHz matches the Waveshare 1024x600
        timing for ~60 fps (htotal 1344, vtotal 635). Lowering the frequency
        reduces bandwidth but can introduce rolling if the panel desynchronises;
        increase cautiously if DMA underflows appear.

config BOARD_LCD_HSYNC_PULSE_WIDTH
    int "HSYNC pulse width"
    default 88

config BOARD_LCD_HSYNC_BACK_PORCH
    int "HSYNC back porch"
    default 140

config BOARD_LCD_HSYNC_FRONT_PORCH
    int "HSYNC front porch"
    default 92

config BOARD_LCD_VSYNC_PULSE_WIDTH
    int "VSYNC pulse width"
    default 3

config BOARD_LCD_VSYNC_BACK_PORCH
    int "VSYNC back porch"
    default 23

config BOARD_LCD_VSYNC_FRONT_PORCH
    int "VSYNC front porch"
    default 9

config BOARD_LCD_PCLK_ACTIVE_NEG
    bool "PCLK active on negative edge"
    default y
    help
        Keep enabled unless your panel requires sampling on the positive clock
        edge. Disabling may help if residual tearing/rolling remains after
        setting correct porches.

config BOARD_LCD_HSYNC_IDLE_LOW
    bool "HSYNC idle level low (active high pulse)"
    default n
    help
        Leave disabled for panels expecting HSYNC active-low pulses (idle high).
        Enable only if your LCD datasheet specifies an idle-low HSYNC level.

config BOARD_LCD_VSYNC_IDLE_LOW
    bool "VSYNC idle level low (active high pulse)"
    default n
    help
        Leave disabled for panels expecting VSYNC active-low pulses (idle high).
        Enable only if your LCD datasheet specifies an idle-low VSYNC level.

config BOARD_LCD_DE_IDLE_HIGH
    bool "DE idle level high"
    default y
    help
        Keep enabled for panels that gate active video when DE is high. Disable
        only if your panel requires DE low during active periods.

config BOARD_LCD_PSRAM_TRANS_ALIGN
    int "PSRAM transfer alignment for RGB framebuffers"
    range 32 256
    default 64
    help
        Align PSRAM RGB transfers to a power-of-two boundary to reduce DMA
        stalls. 64 bytes is safe for most panels; increase to 128 if traces
        show misalignment warnings.

config BOARD_LCD_BYPASS_LVGL_SELFTEST
    bool "Bypass LVGL and loop framebuffer self-test patterns"
    default n
    help
        When enabled, LVGL is skipped and the board driver continuously writes
        solid colours and colour bars directly into the RGB frame buffers after
        panel init. Use this to validate PCLK/polarity/porches independently of
        LVGL. Disable for normal operation.

config BOARD_LCD_SELFTEST_PATTERN
    bool "Run RGB panel bring-up selftest pattern"
    default n
    help
        When enabled, the board driver draws a coloured stripe pattern on the
        LCD immediately after the RGB panel is initialised and before LVGL
        starts. This helps differentiate panel timing/power issues from LVGL
        rendering issues (e.g., flush callbacks not being called).

config BOARD_LCD_DEBUG_PATTERN_AT_BOOT
    bool "Render raw framebuffer debug patterns before LVGL"
    default n
    help
        When enabled, the board driver fills the RGB panel frame buffers with
        solid colours, vertical bars and border patterns immediately after
        initialisation (before LVGL starts). This bypasses LVGL and draws
        directly into the esp_lcd RGB frame buffers to validate timings,
        stride and polarity. Disable once panel bring-up is complete.

endmenu

config BOARD_BATTERY_RAW_FULL
    int "Battery ADC full-scale raw value"
    range 1 255
    default 255
    help
        Raw 8-bit value reported on IO7 by the CH32V003 expander when the battery
        is at 100% charge. Used to scale the battery percentage in board_get_battery_level.

config BOARD_BATTERY_RAW_EMPTY
    int "Battery ADC empty raw value"
    range 0 254
    default 0
    help
        Raw 8-bit value reported on IO7 by the CH32V003 expander when the battery
        is considered empty. Used as the lower bound for percentage scaling.

config BOARD_SD_HOLD_CS_LOW_DIAG
    bool "Force SD CS low during SDSPI init (diagnostic)"
    default n
    help
        Hold EXIO4 (SD_CS via CH422G) low throughout SDSPI initialisation and
        transactions. Useful for diagnosing CS gating/timeout issues coming from
        the IO expander. Disable for normal operation.

config BOARD_REQUIRE_IO_EXPANDER
    bool "Abort boot if IO expander is missing"
    default n
    help
        When enabled, the firmware aborts at boot if the selected IO expander
        does not acknowledge on the I2C bus or fails initialization. When
        disabled (default), the system degrades gracefully and disables
        peripherals that rely on the expander (touch reset, SD CS, backlight
        PWM, battery sense).

config BOARD_ENABLE_SD
    bool "Enable microSD (disabled)"
    default n
    help
        microSD support is permanently disabled in firmware to avoid crashes
        linked to the IO extender. This option remains for compatibility but
        always evaluates to false at runtime; the board will never attempt to
        mount /sdcard.

config BOARD_REQUIRE_I2C_OK
    bool "Abort boot if I2C bus is non-functional"
    default n
    help
        When enabled, the firmware aborts at boot if the I2C self-test cannot
        contact any of the expected peripherals (CH422G or GT911) or the bus
        appears stuck. Disable to allow a degraded boot without I2C devices.

config BOARD_I2C_ENABLE_INTERNAL_PULLUP
    bool "Enable internal pull-ups on I2C pins"
    default y
    help
        Enable the ESP32-S3 internal pull-ups on SDA/SCL when configuring the
        master bus. Disable if strong external pull-ups are present and you
        want to minimize biasing, or for debugging suspected pull-up issues.

config BOARD_I2C_FULL_SCAN_DEBUG
    bool "Perform full I2C scan in debug builds"
    default n
    help
        When enabled, the board driver performs a full 0x03-0x77 I2C scan after
        the targeted probe. This can generate verbose timeout logs from the
        I2C driver and is intended only for deep debugging.

choice BOARD_IOEXP_DRIVER
    prompt "IO expander driver"
    default BOARD_IOEXP_DRIVER_WAVESHARE

config BOARD_IOEXP_DRIVER_WAVESHARE
    bool "Waveshare IO extension (CH32V003 firmware)"
    help
        Use the Waveshare-provided IO extension microcontroller (CH32V003) as
        shipped on recent ESP32-S3-Touch-LCD-7B boards. This backend supports
        PWM backlight and ADC-based battery sense.

config BOARD_IOEXP_DRIVER_CH422G
    bool "Legacy CH422G"
    help
        Use the legacy CH422G IO expander backend for older board revisions
        that kept the CH422G. PWM backlight is emulated as ON/OFF.
endchoice

config BOARD_IOEXP_ALLOW_CH422G_FALLBACK
    bool "Allow CH422G fallback when Waveshare IO extension is missing"
    default y
    help
        When enabled, the firmware will try the legacy CH422G backend if the
        Waveshare IO extension is selected but not detected. Disable when the
        board is known to only ship the CH32V003 firmware.

menu "Backlight"

config BOARD_BACKLIGHT_MAX_DUTY
    int "Valeur maximale du rapport cyclique pour le rétroéclairage (max 8192)"
    range 1 8192
    default 5000
    help
      Valeur maximale du rapport cyclique PWM utilisée pour représenter 100 % de
      luminosité. Ajuster en fonction de la fréquence LEDC et de la courbe du
      driver (résolution LEDC 13 bits).

config BOARD_BACKLIGHT_ACTIVE_LOW
    bool "Backlight PWM active low"
    default n
    help
        Invert PWM polarity for the LCD backlight (active-low enable/inverter).

config BOARD_BACKLIGHT_RAMP_TEST
    bool "Backlight ramp test at boot"
    default n
    help
        If enabled, perform a short brightness ramp test during board init.

endmenu

config BOARD_BATTERY_ENABLE
    bool "Enable battery sensing via IO expander"
    default n
    help
        When enabled, the board driver reads battery level via the IO
        expander. Disable when no battery is connected to avoid useless
        transactions and logs.

config BOARD_I2C_PORT
    int "I2C controller number"
    range 0 1
    default 0

config BOARD_I2C_SDA
    int "I2C SDA GPIO"
    range 0 48
    default 8

config BOARD_I2C_SCL
    int "I2C SCL GPIO"
    range 0 48
    default 9

endmenu
```

## components/net/Kconfig
```kconfig
menu "Network Manager"

config NET_WIFI_SSID
    string "Default WiFi SSID"
    default ""
    help
        Optional Wi-Fi SSID used when no credentials are provisioned in NVS (namespace "net").

config NET_WIFI_PASS
    string "Default WiFi password"
    default ""
    help
        Optional Wi-Fi password used when no credentials are provisioned in NVS (namespace "net").

endmenu
```

## components/ui/Kconfig
```kconfig
menu "UI"

config UI_FORCE_HIGH_CONTRAST
    bool "Force high-contrast fallback screen (white background, BONJOUR)"
    default n
    help
        When enabled, LVGL displays a high-contrast fallback screen (white
        background with a centered black "BONJOUR" label) instead of the
        standard UI. Use this to rule out dark-on-dark rendering during
        display bring-up.

endmenu
```

## sdkconfig.defaults
```kconfig
# ESP32-S3 Specific
CONFIG_IDF_TARGET="esp32s3"

# Flash Size (16MB Required for dual ~4MB OTA slots + 8MB Storage)
CONFIG_ESPTOOLPY_FLASHSIZE_16MB=y

# Partition Table
CONFIG_PARTITION_TABLE_CUSTOM=y
CONFIG_PARTITION_TABLE_CUSTOM_FILENAME="partitions.csv"
CONFIG_PARTITION_TABLE_FILENAME="partitions.csv"

# PSRAM (Required for RGB Panel & LVGL)
CONFIG_SPIRAM=y
CONFIG_SPIRAM_MODE_OCT=y
CONFIG_SPIRAM_SPEED_80M=y
CONFIG_SPIRAM_USE_MALLOC=y
CONFIG_SPIRAM_MEMTEST=y
CONFIG_SPIRAM_FETCH_INSTRUCTIONS=y
CONFIG_SPIRAM_RODATA=y
CONFIG_FREERTOS_TASK_CREATE_ALLOW_EXT_MEM=y
CONFIG_ESP32S3_DATA_CACHE_LINE_32B=y
CONFIG_ESP_DEFAULT_CPU_FREQ_MHZ=240

# Compiler optimizations
CONFIG_COMPILER_OPTIMIZATION_PERF=y

# LVGL Configuration (v9.4)
CONFIG_LV_COLOR_DEPTH_16=y
CONFIG_LV_OS_FREERTOS=y

# Board calibration (battery ADC scaling)
CONFIG_BOARD_BATTERY_RAW_FULL=255
CONFIG_BOARD_BATTERY_RAW_EMPTY=0
CONFIG_BOARD_SD_HOLD_CS_LOW_DIAG=n
CONFIG_BOARD_ENABLE_SD=n
CONFIG_BOARD_I2C_PORT=0
CONFIG_BOARD_I2C_SDA=8
CONFIG_BOARD_I2C_SCL=9
CONFIG_BOARD_IOEXP_DRIVER_WAVESHARE=y
CONFIG_BOARD_IOEXP_ALLOW_CH422G_FALLBACK=y
CONFIG_BOARD_BATTERY_ENABLE=n
CONFIG_BOARD_BACKLIGHT_MAX_DUTY=5000
CONFIG_BOARD_BACKLIGHT_ACTIVE_LOW=n
CONFIG_BOARD_BACKLIGHT_RAMP_TEST=n
CONFIG_LCD_RGB_ISR_IRAM_SAFE=y
CONFIG_LCD_RGB_RESTART_IN_VSYNC=y

# Display
# Increase main task stack size for initialization
CONFIG_ESP_MAIN_TASK_STACK_SIZE=8192
CONFIG_BOARD_LCD_PCLK_HZ=51200000
CONFIG_BOARD_LCD_PCLK_ACTIVE_NEG=y
CONFIG_BOARD_LCD_HSYNC_IDLE_LOW=n
CONFIG_BOARD_LCD_VSYNC_IDLE_LOW=n
CONFIG_BOARD_LCD_DE_IDLE_HIGH=y
CONFIG_BOARD_LCD_DEBUG_PATTERN_AT_BOOT=n
CONFIG_BOARD_LCD_SELFTEST_PATTERN=n
CONFIG_LV_COLOR_16_SWAP=n
CONFIG_ESP_TASK_WDT_TIMEOUT_S=15

# HTTP Server
CONFIG_HTTPD_MAX_REQ_HDR_LEN=1024
CONFIG_HTTPD_MAX_URI_LEN=1024

# FATFS
CONFIG_FATFS_LFN_HEAP=y
CONFIG_FATFS_MAX_LFN=255
```
